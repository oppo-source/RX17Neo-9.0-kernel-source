/* Copyright (c) 2017, The Linux Foundation. All rights reserved.
 *
 * This program is free software; you can redistribute it and/or modify
 * it under the terms of the GNU General Public License version 2 and
 * only version 2 as published by the Free Software Foundation.
 *
 * This program is distributed in the hope that it will be useful,
 * but WITHOUT ANY WARRANTY; without even the implied warranty of
 * MERCHANTABILITY or FITNESS FOR A PARTICULAR PURPOSE.  See the
 * GNU General Public License for more details.
 */

&mdss_mdp {
	dsi_oppo18316dpt_jdi_nt36672a_1080_2340_video: qcom,mdss_dsi_oppo18316dpt_jdi_nt36672a_1080_2340_video {
		qcom,cont-splash-enabled;
		qcom,mdss-dsi-panel-name = "qcom,mdss_dsi_oppo18316dpt_jdi_nt36672a_1080_2340_video";
		qcom,mdss-dsi-panel-manufacture = "DPT4096";
		qcom,mdss-dsi-panel-version = "NT36672A";
		qcom,mdss-dsi-panel-controller = <&mdss_dsi0>;
		qcom,mdss-dsi-panel-destination = "display_1";
		qcom,mdss-dsi-panel-type = "dsi_video_mode";
		qcom,mdss-dsi-panel-framerate = <60>;
		qcom,mdss-dsi-virtual-channel-id = <0>;
		qcom,mdss-dsi-stream = <0>;
		qcom,mdss-dsi-panel-width = <1080>;
		qcom,mdss-dsi-panel-height = <2340>;
		qcom,mdss-dsi-h-front-porch = <16>;
		qcom,mdss-dsi-h-back-porch = <16>;
		qcom,mdss-dsi-h-pulse-width = <2>;
		qcom,mdss-dsi-h-sync-skew = <0>;
		qcom,mdss-dsi-v-back-porch = <15>;
		qcom,mdss-dsi-v-front-porch = <32>;
		qcom,mdss-dsi-v-pulse-width = <2>;
		qcom,mdss-dsi-h-left-border = <0>;
		qcom,mdss-dsi-h-right-border = <0>;
		qcom,mdss-dsi-v-top-border = <0>;
		qcom,mdss-dsi-v-bottom-border = <0>;
		qcom,mdss-dsi-bpp = <24>;
		qcom,mdss-dsi-underflow-color = <0xff>;
		qcom,mdss-dsi-border-color = <0>;
		qcom,mdss-dsi-h-sync-pulse = <0>;
		qcom,mdss-dsi-traffic-mode = "burst_mode";
		qcom,mdss-dsi-bllp-eof-power-mode;
		qcom,mdss-dsi-bllp-power-mode;
		qcom,mdss-dsi-lane-0-state;
		qcom,mdss-dsi-lane-1-state;
		qcom,mdss-dsi-lane-2-state;
		qcom,mdss-dsi-lane-3-state;
		qcom,mdss-dsi-panel-timings = [e6 38 26 00 68 6e 2a
				3c 44 03 04 00];
		qcom,mdss-dsi-t-clk-post = <0x0d>;
		qcom,mdss-dsi-t-clk-pre = <0x2f>;
		qcom,mdss-dsi-bl-min-level = <1>;
		qcom,mdss-brightness-max-level = <4095>;
		qcom,mdss-dsi-bl-max-level = <4095>;
		qcom,mdss-dsi-dma-trigger = "trigger_sw";
		qcom,mdss-dsi-mdp-trigger = "none";
		qcom,mdss-dsi-on-command = [
				15 01 00 00 00 00 02 FF 23
				15 01 00 00 00 00 02 FB 01
				15 01 00 00 00 00 02 08 04
				15 01 00 00 00 00 02 FF 10
				15 01 00 00 00 00 02 FB 01
				15 01 00 00 00 00 06 3B 03 0A 0A 04 04
				15 01 00 00 00 00 02 FF 20
				15 01 00 00 00 00 02 FB 01
				15 01 00 00 00 00 02 06 9B
				15 01 00 00 00 00 02 07 A1
				15 01 00 00 00 00 02 0E AD
				15 01 00 00 00 00 02 0F AC
				15 01 00 00 00 00 02 62 AB
				15 01 00 00 00 00 02 6D 44
				15 01 00 00 00 00 02 FF 24
				15 01 00 00 00 00 02 FB 01
				15 01 00 00 00 00 02 00 1C
				15 01 00 00 00 00 02 01 0D
				15 01 00 00 00 00 02 02 1C
				15 01 00 00 00 00 02 03 0A
				15 01 00 00 00 00 02 04 1C
				15 01 00 00 00 00 02 05 23
				15 01 00 00 00 00 02 06 1C
				15 01 00 00 00 00 02 07 1C
				15 01 00 00 00 00 02 08 06
				15 01 00 00 00 00 02 09 05
				15 01 00 00 00 00 02 0A 04
				15 01 00 00 00 00 02 0B 03
				15 01 00 00 00 00 02 0C 1C
				15 01 00 00 00 00 02 0D 1C
				15 01 00 00 00 00 02 0E 1C
				15 01 00 00 00 00 02 0F 1C
				15 01 00 00 00 00 02 10 1C
				15 01 00 00 00 00 02 11 14
				15 01 00 00 00 00 02 12 10
				15 01 00 00 00 00 02 13 12
				15 01 00 00 00 00 02 14 1C
				15 01 00 00 00 00 02 15 11
				15 01 00 00 00 00 02 16 13
				15 01 00 00 00 00 02 17 1C
				15 01 00 00 00 00 02 18 1C
				15 01 00 00 00 00 02 19 1C
				15 01 00 00 00 00 02 1A 01
				15 01 00 00 00 00 02 1B 1C
				15 01 00 00 00 00 02 1C 23
				15 01 00 00 00 00 02 1D 1C
				15 01 00 00 00 00 02 1E 1C
				15 01 00 00 00 00 02 1F 06
				15 01 00 00 00 00 02 20 05
				15 01 00 00 00 00 02 21 04
				15 01 00 00 00 00 02 22 03
				15 01 00 00 00 00 02 23 1C
				15 01 00 00 00 00 02 24 1C
				15 01 00 00 00 00 02 25 1C
				15 01 00 00 00 00 02 26 1C
				15 01 00 00 00 00 02 27 1C
				15 01 00 00 00 00 02 28 14
				15 01 00 00 00 00 02 29 10
				15 01 00 00 00 00 02 2A 12
				15 01 00 00 00 00 02 2B 1C
				15 01 00 00 00 00 02 2D 11
				15 01 00 00 00 00 02 2F 13
				15 01 00 00 00 00 02 31 04
				15 01 00 00 00 00 02 32 08
				15 01 00 00 00 00 02 33 00
				15 01 00 00 00 00 02 34 00
				15 01 00 00 00 00 02 35 00
				15 01 00 00 00 00 02 37 22
				15 01 00 00 00 00 02 38 5F
				15 01 00 00 00 00 02 39 5F
				15 01 00 00 00 00 02 3F 5F
				15 01 00 00 00 00 02 41 04
				15 01 00 00 00 00 02 42 08
				15 01 00 00 00 00 02 4C 15
				15 01 00 00 00 00 02 4D 15
				15 01 00 00 00 00 02 60 90
				15 01 00 00 00 00 02 61 24
				15 01 00 00 00 00 02 62 03
				15 01 00 00 00 00 02 6F 90
				15 01 00 00 00 00 02 72 00
				15 01 00 00 00 00 02 73 00
				15 01 00 00 00 00 02 74 00
				15 01 00 00 00 00 02 75 00
				15 01 00 00 00 00 02 79 01
				15 01 00 00 00 00 02 7A 03
				15 01 00 00 00 00 02 7B 9C
				15 01 00 00 00 00 02 7C 80
				15 01 00 00 00 00 02 7D 05
				15 01 00 00 00 00 02 80 42
				15 01 00 00 00 00 02 82 13
				15 01 00 00 00 00 02 83 22
				15 01 00 00 00 00 02 84 31
				15 01 00 00 00 00 02 85 00
				15 01 00 00 00 00 02 86 00
				15 01 00 00 00 00 02 87 00
				15 01 00 00 00 00 02 88 13
				15 01 00 00 00 00 02 89 22
				15 01 00 00 00 00 02 8A 31
				15 01 00 00 00 00 02 8B 00
				15 01 00 00 00 00 02 8C 00
				15 01 00 00 00 00 02 8D 00
				15 01 00 00 00 00 02 8E F4
				15 01 00 00 00 00 02 8F 01
				15 01 00 00 00 00 02 90 80
				15 01 00 00 00 00 02 92 73
				15 01 00 00 00 00 02 93 20
				15 01 00 00 00 00 02 94 11
				15 01 00 00 00 00 02 B3 22
				15 01 00 00 00 00 02 B4 85
				15 01 00 00 00 00 02 B5 54
				15 01 00 00 00 00 02 C2 86
				15 01 00 00 00 00 02 DC 00
				15 01 00 00 00 00 02 DE 10
				15 01 00 00 00 00 02 DF 39
				15 01 00 00 00 00 02 E0 39
				15 01 00 00 00 00 02 EB 03
				15 01 00 00 00 00 02 EF 14
				15 01 00 00 00 00 02 F0 01
				15 01 00 00 00 00 02 F3 40
				15 01 00 00 00 00 02 FF 25
				15 01 00 00 00 00 02 FB 01
				15 01 00 00 00 00 02 21 1C
				15 01 00 00 00 00 02 22 1C
				15 01 00 00 00 00 02 24 73
				15 01 00 00 00 00 02 25 73
				15 01 00 00 00 00 02 68 50
				15 01 00 00 00 00 02 69 10
				15 01 00 00 00 00 02 6B 00
				15 01 00 00 00 00 02 6D 0D
				15 01 00 00 00 00 02 71 5D
				15 01 00 00 00 00 02 72 31
				15 01 00 00 00 00 02 73 48
				15 01 00 00 00 00 02 74 12
				15 01 00 00 00 00 02 77 70
				15 01 00 00 00 00 02 78 85
				15 01 00 00 00 00 02 7D 40
				15 01 00 00 00 00 02 7E 1D
				15 01 00 00 00 00 02 7F 00
				15 01 00 00 00 00 02 84 4D
				15 01 00 00 00 00 02 BC 23
				15 01 00 00 00 00 02 BF C0
				15 01 00 00 00 00 02 D0 80
				15 01 00 00 00 00 02 D9 69
				15 01 00 00 00 00 02 FF 26
				15 01 00 00 00 00 02 FB 01
				15 01 00 00 00 00 02 06 FF
				15 01 00 00 00 00 02 0C 11
				15 01 00 00 00 00 02 0F 09
				15 01 00 00 00 00 02 10 0A
				15 01 00 00 00 00 02 12 82
				15 01 00 00 00 00 02 1A EE
				15 01 00 00 00 00 02 1C AF
				15 01 00 00 00 00 02 1D 0B
				15 01 00 00 00 00 02 1E 71
				15 01 00 00 00 00 02 98 F1
				15 01 00 00 00 00 02 9A 81
				15 01 00 00 00 00 02 9D 00
				15 01 00 00 00 00 02 9E 01
				15 01 00 00 00 00 02 A9 11
				15 01 00 00 00 00 02 AE 42
				15 01 00 00 00 00 02 AF 06
				15 01 00 00 00 00 02 B1 05
				15 01 00 00 00 00 02 B2 2C
				15 01 00 00 00 00 02 B4 AE
				15 01 00 00 00 00 02 FF 27
				15 01 00 00 00 00 02 FB 01
				15 01 00 00 00 00 02 13 00
				15 01 00 00 00 00 02 1E 15
				15 01 00 00 00 00 02 FF F0
				15 01 00 00 00 00 02 FB 01
				15 01 00 00 00 00 02 A2 00
				15 01 00 00 00 00 02 FF 10
				15 01 00 00 00 00 02 FB 01
				15 01 00 00 78 00 02 11 00
				15 01 00 00 00 00 02 51 FF
				15 01 00 00 00 00 02 53 2C
				15 01 00 00 00 00 02 55 02
				15 01 00 00 00 00 02 35 00
				15 01 00 00 78 00 02 29 00];
		qcom,mdss-dsi-off-command = [
				05 01 00 00 14 00 02 28 00
				05 01 00 00 78 00 02 10 00];
		qcom,mdss-dsi-on-command-state = "dsi_lp_mode";
		qcom,mdss-dsi-off-command-state = "dsi_lp_mode";
		qcom,mdss-dsi-lp11-init;
		qcom,mdss-dsi-init-delay-us = <5000>;
		qcom,mdss-dsi-bl-pmic-control-type = "bl_ctrl_wled";
		qcom,mdss-dsi-reset-sequence = <1 10>, <0 10>, <1 10>;
		qcom,mdss-dsi-tx-eot-append;
		qcom,mdss-dsi-post-init-delay = <1>;
	};
};
